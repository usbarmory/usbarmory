## software/secure_boot/imx6ul-pico/pico.its
```
/dts-v1/;

/ {
	description = "Technexion Pico i.MX6UL Board FIT file";
	#address-cells = <1>;

	images {
		kernel@1 {
			description = "Vanilla Linux kernel";
			data = /incbin/("arch/arm/boot/zImage");
			type = "kernel_noload";
			compression = "none";
			arch = "arm";
			os = "linux";
			load = <0>;
			entry = <0>;
			kernel-version = <1>;
			hash@1 {
				algo = "sha256";
			};
		};
		fdt@1 {
			description = "Technexion Pico i.MX6UL Board devicetree blob";
			data = /incbin/("arch/arm/boot/dts/imx6ul-pico-hobbit-caam.dtb");
			type = "flat_dt";
			compression = "none";
			arch = "arm";
			fdt-version = <1>;
			hash@1 {
				algo = "sha256";
			};
		};
	};

	configurations {
		default = "conf@1";
		conf@1 {
			kernel = "kernel@1";
			fdt = "fdt@1";
			signature@1 {
				algo = "sha256,rsa2048";
				key-name-hint = "pico";
				sign-images = "fdt", "kernel";
			};
		};
	};
};
```

## software/secure_boot/mark-two/usbarmory-mark-two_defconfig
```kconfig
CONFIG_ARM=y
CONFIG_ARCH_MX6=y
CONFIG_SYS_TEXT_BASE=0x87800000
CONFIG_TARGET_USBARMORY_MKII=y
# CONFIG_CMD_BMODE is not set
CONFIG_DISTRO_DEFAULTS=y
CONFIG_NR_DRAM_BANKS=1
CONFIG_BOARD_EARLY_INIT_F=y
# CONFIG_USE_BOOTCOMMAND is not set
CONFIG_CMD_MEMTEST=y
CONFIG_CMD_FUSE=y
CONFIG_CMD_I2C=y
CONFIG_CMD_MMC=y
CONFIG_CMD_USB=y
# CONFIG_CMD_SETEXPR is not set
CONFIG_FSL_ESDHC=y
CONFIG_USB=y
CONFIG_USB_GADGET=y
CONFIG_USB_GADGET_DOWNLOAD=y
CONFIG_OF_LIBFDT=y
CONFIG_CMD_USB_MASS_STORAGE=y
CONFIG_USB_GADGET_MANUFACTURER="FSL"
CONFIG_USB_GADGET_VENDOR_NUM=0x0525
CONFIG_USB_GADGET_PRODUCT_NUM=0xa4a5
CONFIG_CI_UDC=y
# CONFIG_IMX_WATCHDOG is not set
CONFIG_SECURE_BOOT=y
CONFIG_BOOTDELAY=-2
CONFIG_DM=y
CONFIG_FIT=y
CONFIG_OF_CONTROL=y
CONFIG_OF_SEPARATE=y
CONFIG_FIT_SIGNATURE=y
CONFIG_RSA=y
CONFIG_RSA_SOFTWARE_EXP=y
CONFIG_ENV_IS_NOWHERE=y
# CONFIG_ENV_IS_IN_MMC is not set
```

## software/secure_boot/mark-two/usbarmory-tamago.its
```
/dts-v1/;

/ {
	description = "USB armory FIT file";
	#address-cells = <1>;

	images {
		kernel@1 {
			description = "Go unikernel";
			data = /incbin/("tamago.elf");
			type = "firmware";
			os = "u-boot";
			arch = "arm";
			compression = "none";
			load = <0>;
			entry = <0>;
			hash@1 {
				algo = "sha256";
			};
		};
	};

	configurations {
		default = "conf@1";
		conf@1 {
			kernel = "kernel@1";
			signature@1 {
				algo = "sha256,rsa2048";
				key-name-hint = "usbarmory";
				sign-images = "kernel";
			};
		};
	};
};
```

## software/secure_boot/mark-two/usbarmory.its
```
/dts-v1/;

/ {
	description = "USB armory FIT file";
	#address-cells = <1>;

	images {
		kernel@1 {
			description = "Vanilla Linux kernel";
			data = /incbin/("arch/arm/boot/zImage");
			type = "kernel_noload";
			compression = "none";
			arch = "arm";
			os = "linux";
			load = <0>;
			entry = <0>;
			kernel-version = <1>;
			hash@1 {
				algo = "sha256";
			};
		};
		fdt@1 {
			description = "USB armory devicetree blob";
			data = /incbin/("arch/arm/boot/dts/imx6ull-usbarmory.dtb");
			type = "flat_dt";
			compression = "none";
			arch = "arm";
			fdt-version = <1>;
			hash@1 {
				algo = "sha256";
			};
		};
	};

	configurations {
		default = "conf@1";
		conf@1 {
			kernel = "kernel@1";
			fdt = "fdt@1";
			signature@1 {
				algo = "sha256,rsa2048";
				key-name-hint = "usbarmory";
				sign-images = "fdt", "kernel";
			};
		};
	};
};
```

## software/verified_boot/usbarmory.its
```
/dts-v1/;

/ {
	description = "USB armory FIT file";
	#address-cells = <1>;

	images {
		kernel@1 {
			description = "Vanilla Linux kernel";
			data = /incbin/("SET_LINUX_SRC_PATH/arch/arm/boot/zImage");
			type = "kernel";
			compression = "none";
			arch = "arm";
			os = "linux";
			load = <0x70008000>;
			entry = <0x70008000>;
			kernel-version = <1>;
			hash@1 {
				algo = "sha256";
			};
		};
		fdt@1 {
			description = "USB armory devicetree blob";
			data = /incbin/("SET_LINUX_SRC_PATH/arch/arm/boot/dts/imx53-usbarmory.dtb");
			type = "flat_dt";
			compression = "none";
			arch = "arm";
			fdt-version = <1>;
			hash@1 {
				algo = "sha256";
			};
		};
	};

	configurations {
		default = "conf@1";
		conf@1 {
			kernel = "kernel@1";
			fdt = "fdt@1";
			signature@1 {
				algo = "sha256,rsa2048";
				key-name-hint = "usbarmory";
				sign-images = "fdt", "kernel";
			};
		};
	};
};
```
