/dts-v1/;

/ {
	model = "Technexion Pico i.MX6UL Board - U-Boot public keys";
	compatible = "technexion,imx6ul-pico-hobbit", "fsl,imx6ul";
	signature {
		sig@0 {
			required = "conf";
			algo = "sha256,rsa2048";
			key-name-hint = "pico";
		};
	};
};
