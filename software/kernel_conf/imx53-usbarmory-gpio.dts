/*
 * USB armory MkI device mode device tree file
 * https://inversepath.com/usbarmory
 *
 * Copyright (C) 2015, Inverse Path
 * Andrej Rosano <andrej@inversepath.com>
 *
 * Licensed under GPLv2
 */

/dts-v1/;

#include "imx53-usbarmory-common.dtsi"

&usbotg {
	dr_mode = "peripheral";
	status = "okay";
};

&iomuxc {
	pinctrl-0 = <&pinctrl_gpio5>;
};

&uart1 {
	status = "disabled";
};
